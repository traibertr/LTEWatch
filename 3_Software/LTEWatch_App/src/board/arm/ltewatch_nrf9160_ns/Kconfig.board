## 3_Software/LTEWatch_App/src/board/arm/ltewatch_nrf9160_ns/Kconfig.board
```kconfig
# nRF9160 DK NRF9160 board configuration

# Copyright (c) 2018-2020 Nordic Semiconductor ASA
# SPDX-License-Identifier: Apache-2.0

if SOC_NRF9160_SICA

config BOARD_LTEWATCH_NRF9160
	bool "LTEWatch nRF9160"

config BOARD_LTEWATCH_NRF9160_NS
	bool "LLTEWatch nRF9160 non-secure"

endif # SOC_NRF9160_SICA
```
